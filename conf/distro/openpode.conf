## conf/distro/openpode.conf
```bitbake
require conf/distro/poky.conf

DISTRO = "openpode"
DISTRO_NAME = "OpenPode Distribution"
DISTRO_VERSION = "1.0-${DATE}"
DISTRO_CODENAME = "opdist"
DISTRO_FEATURES_append = " bluez5 wifi bluetooth systemd"
SDK_VENDOR = "-openpodesdk"
SDK_VERSION = "${DISTRO_VERSION}"
MAINTAINER = "OpenPode team <open-pode@gmail.com>"

# Enable buildhistory
INHERIT += "buildhistory"
BUILDHISTORY_COMMIT = "1" 

# Enable systemd
VIRTUAL-RUNTIME_init_manager = "systemd"
DISTRO_FEATURES_BACKFILL_CONSIDERED = "sysvinit"
VIRTUAL-RUNTIME_initscripts = ""

# Set U-boot as bootloader
KERNEL_IMAGETYPE = "uImage"
IMAGE_DEPENDS_sdimg += " bcm2835-bootfiles"
IMAGE_BOOT_FILES_append = " boot.scr u-boot.bin;${SDIMG_KERNELIMAGE}"
IMAGE_INSTALL_append = " kernel-image kernel-devicetree"

# Add some packages and features
IMAGE_FEATURES_append = " ssh-server-openssh "
IMAGE_INSTALL_append =	" nano bluez5 i2c-tools "
```
